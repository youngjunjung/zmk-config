## boards/shields/pelit/Kconfig.defconfig
```kconfig
if SHIELD_PELIT_LEFT

config ZMK_KEYBOARD_NAME
    default "Pelit"

config ZMK_SPLIT_ROLE_CENTRAL
    default y

endif


if SHIELD_PELIT_LEFT || SHIELD_PELIT_RIGHT

config ZMK_SPLIT
    default y

config BT
    default y

config ZMK_BLE
    default y

endif
```

## config/boards/shields/pelit/Kconfig.shield
```kconfig
config SHIELD_PELIT_LEFT
    def_bool $(shields_list_contains,pelit_left)

config SHIELD_PELIT_RIGHT
    def_bool $(shields_list_contains,pelit_right)
```
